## boards/shields/kyria_rev3/Kconfig.defconfig
```kconfig
if SHIELD_KYRIA_REV3_LEFT
config ZMK_POINTING
    default y
endif

if SHIELD_KYRIA_REV3_RIGHT
config I2C
    default y
config ZMK_POINTING
    default y
endif
```

## config/west.yml
```yaml
manifest:
  remotes:
    - name: zmkfirmware
      url-base: https://github.com/zmkfirmware
  projects:
    - name: zmk
      remote: zmkfirmware
      revision: main
      import: app/west.yml
    - name: nice-view-gem
      remote: m165437
      revision: main
  self:
    path: config
```
