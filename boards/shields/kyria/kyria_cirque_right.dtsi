#include <dt-bindings/zmk/keys.h>
#include <dt-bindings/zmk/outputs.h>

/ {
    chosen {
        zmk,kscan = &matrix;
        zmk,matrix_transform = &matrix_transform;
    };

    matrix: matrix {
        compatible = "zmk,kscan-gpio-matrix";
        debounce-press-ms = <5>;
        debounce-release-ms = <5>;
        scan-interval-ms = <1>;
        row-gpios =
        <&gpio0 29 GPIO_ACTIVE_LOW>,  // Exemple: R0
        <&gpio0 30 GPIO_ACTIVE_LOW>; // Exemple: R1
        col-gpios =
        <&gpio0 2 GPIO_ACTIVE_LOW>,  // Exemple: C0
        <&gpio0 3 GPIO_ACTIVE_LOW>;  // Exemple: C1
    };

    matrix_transform: matrix_transform {
        compatible = "zmk,matrix-transform";
        rows = <5>;   // Nombre de lignes de ta matrice
        cols = <6>;   // Nombre de colonnes de ta matrice
        map = <
        0  1  2  3  4  5
        6  7  8  9 10 11
        12 13 14 15 16 17
        18 19 20 21 22 23
        24 25 26 27 28 29
        >;
    };
};
