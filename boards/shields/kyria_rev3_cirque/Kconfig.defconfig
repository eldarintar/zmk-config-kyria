## boards/shields/kyria_rev3_cirque/Kconfig.defconfig
```kconfig
if SHIELD_KYRIA_REV3_CIRQUE_LEFT
config ZMK_POINTING
    default y
endif

if SHIELD_KYRIA_REV3_CIRQUE_RIGHT
config I2C
    default y
config ZMK_POINTING
    default y
endif
```

## boards/shields/kyria_rev3_cirque/Kconfig.shield
```kconfig
config SHIELD_KYRIA_REV3_CIRQUE_LEFT
    def_bool $(shields_list_contains,kyria_rev3_cirque_left)

config SHIELD_KYRIA_REV3_CIRQUE_RIGHT
    def_bool $(shields_list_contains,kyria_rev3_cirque_right)
```
