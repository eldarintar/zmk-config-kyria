/ {
    split_inputs {
        #address-cells = <1>;
        #size-cells = <0>;

        glidepoint_split: glidepoint_split@0 {
            compatible = "cirque,pinnacle";
            reg = <0>;
        };
    };

    glidepoint_listener: glidepoint_listener {
        compatible = "cirque,pinnacle";
        status = "disabled";
        device = <&glidepoint_split>;
    };
};
