/ {
    split_inputs {
        #address-cells = <1>;
        #size-cells = <0>;

        cirque_split: cirque_split@0 {
            compatible = "cirque,pinnacle";
            reg = <0>;
        };
    };

    cirque_listener: cirque_listener {
        compatible = "cirque,pinnacle";
        status = "disabled";
        device = <&cirque_split>;
    };
};
