&pro_micro_i2c {
    status = "okay";

    glidepoint: glidepoint@2a {
        compatible = "cirque,pinnacle";
        reg = <0x2a>;
        status = "okay";
        sensitivity = "4x";
        diameter-mm = <40>;
        sleep-mode-enable;
        primary-tap-enable;
    };
};
